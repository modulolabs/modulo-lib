#include "Modulo.h"
#include "Wire.h"

IRRemoteModulo ir;
DisplayModulo display;

void irReceiveCallback(int8_t protocol, uint32_t value, uint16_t *rawData, uint8_t rawLen) {
    Serial.print("Receive: ");
    Serial.print(protocol);
    Serial.print(" ");
    Serial.print(value);
    Serial.print(" ");
    Serial.print(rawLen);
    Serial.print(" {");
    for (int i=0; i < rawLen; i++) {
        Serial.print(rawData[i]);
        if (i != rawLen-1) {
            Serial.print(",");
        }
    }
    Serial.println("}");
}

void onButtonPressed(DisplayModulo &, int button) {

    uint8_t volUp[] = {0,19,17,18,18,18,17,36,17,18,17,18,18,18,17,18,35,36,17,18,17,18,17,19};
    uint8_t volUpLen = 24;

    uint8_t volDown[] = {0,18,17,36,35,36,17,18,17,19,17,18,17,18,35,36,17,18,17,18,35,18};
    uint8_t volDownLen = 22;

    if (button == 0) {
        ir.send(volDown, volDownLen);
    } else {
        ir.send(volUp, volUpLen);
    }

    //int len = 70;
    //uint8_t data[] = {255,143,72,11,7,11,7,10,9,10,27,9,9,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25,12};
    //ir.send(data, len);
}

void setup() {
    Serial.begin(9600);
    ir.setReceiveCallback(&irReceiveCallback);
    display.setButtonPressCallback(onButtonPressed);
}

//
// Power Button:
//    int len = 70
//    uint16_t data[] = {14098,143,72,11,7,11,7,10,9,10,27,9,9,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25,12};
//    int len = 70
//    uint16_t data[] = {4484,146,73,8,9,10,8,10,8,10,27,9,9,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25,10};
// Select Button:
//    uint16_t data[] = {65535,144,71,12,7,10,8,10,7,10,26,10,9,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25,10};
//    int len = 70
//    uint16_t data[] = {12292,143,74,9,7,9,9,9,9,8,27,10,8,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27,9};
//    int len = 70
//    uint16_t data[] = {38530,145,73,11,6,12,6,11,8,11,26,10,7,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26,9};
// A Button:
//    int len = 70
//    uint16_t data[] = {8361,142,73,10,9,9,9,8,10,9,27,10,7,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27,10};
//    int len = 70
//    uint16_t data[] = {6118,143,71,9,9,9,9,9,9,11,26,10,9,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27,10};
//    int len = 70
//    uint16_t data[] = {6723,145,74,8,8,9,10,9,9,9,25,12,8,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26,10};
// Repeat Code:
//    int len = 6
//    uint16_t data[] = {661,156,34,11};
//    int len = 6
//    uint16_t data[] = {1528,145,35,11};
//    int len = 6
//    uint16_t data[] = {659,155,35,11};



void loop() {
    Modulo.loop();
}